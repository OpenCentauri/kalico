## src/aw_r528/Kconfig
```kconfig
# Kconfig settings for compiling and running the micro-controller code
# in a Linux process

if MACH_ALLWINNER_R528

config LINUX_SELECT
    bool
    default y
    select HAVE_GPIO
    select HAVE_GPIO_ADC
    select HAVE_GPIO_SPI
    select HAVE_GPIO_HARD_PWM

config BOARD_DIRECTORY
    string
    default "aw_r528"

endif
```

## src/hifi4/Kconfig
```kconfig
# Kconfig settings for HIFI4 DSP

if MACH_HIFI4

config BOARD_DIRECTORY
    string
    default "hifi4"

config HIFI4_SELECT
    bool
    default y
    select HAVE_GPIO
    select HAVE_GPIO_ADC
    select HAVE_GPIO_SPI
    select HAVE_GPIO_HARD_PWM

config CLOCK_FREQ
    int
    default 200000000

config HIFI4_WATCHDOG
    bool
    default y

choice
    prompt "Communication Interface"
    config HIFI4_MSGBOX
        bool "MSGBOX"
        select MSGBOX
    config HIFI4_SERIAL_UART0
        bool "UART0"
        select SERIAL
    config HIFI4_SERIAL_UART1
        bool "UART1"
        select SERIAL
    config HIFI4_SERIAL_UART2
        bool "UART2"
        select SERIAL
    config HIFI4_SERIAL_UART3
        bool "UART3"
        select SERIAL
endchoice

endif
```

## src/sunxi/Kconfig
```kconfig
# Kconfig settings for compiling and running the firmware on Allwinner 
# T113/R528 Hifi4 DSP platform

if MACH_SUNXI

config SUNXI_SELECT
    bool
    default y
    select HAVE_GPIO
    select HAVE_GPIO_ADC
    select HAVE_GPIO_SPI
    select HAVE_GPIO_HARD_PWM

config BOARD_DIRECTORY
    string
    default "sunxi"

config SERIAL
    default y

config CLOCK_FREQ
    int
    default 600000000

endif
```
